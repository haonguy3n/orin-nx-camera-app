## yocto/meta-vc-camera/conf/layer.conf
```bitbake
# meta-vc-camera: VC MIPI dual-IMX296 camera device layer for Jetson Orin NX.
# See docs/DESIGN.md (repo root) sections 2.1/2.2.

BBPATH .= ":${LAYERDIR}"

BBFILES += "${LAYERDIR}/recipes-*/*/*.bb \
            ${LAYERDIR}/recipes-*/*/*.bbappend \
            ${LAYERDIR}/recipes-*/*.bb \
            ${LAYERDIR}/recipes-*/*.bbappend"


BBFILE_COLLECTIONS += "vc-camera"
BBFILE_PATTERN_vc-camera = "^${LAYERDIR}/"
# Above meta-tegra (5) and meta-tegrademo (50) so our bbappends/recipes win.
BBFILE_PRIORITY_vc-camera = "60"

LAYERVERSION_vc-camera = "1"
LAYERSERIES_COMPAT_vc-camera = "scarthgap"

# core: oe-core; tegra: meta-tegra (kernel bbappend, NV gst plugins);
# tegrademo: demo-image-base which camera-image requires;
# networking-layer: dnsmasq; openembedded-layer: v4l-utils.
LAYERDEPENDS_vc-camera = "core tegra tegrademo networking-layer openembedded-layer"

# Absolute location of this layer, captured at parse time. Recipes use it to
# reach sibling directories of the same git repository (the camera-streamer
# application sources live at <repo>/embedded, next to <repo>/yocto/...).
VC_CAMERA_LAYERDIR := "${LAYERDIR}"
```
